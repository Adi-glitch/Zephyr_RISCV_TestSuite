## zephyr-suite/p0_sanity/testcase.yaml
```yaml
common:
  tags: riscv sanity
tests:
  app.zephyr_suite.p0_sanity:
    # Needs S-mode (sstatus CSR, S-mode trap path).
    platform_allow:
      - qemu_riscv64/qemu_virt_riscv64/smode
    integration_platforms:
      - qemu_riscv64/qemu_virt_riscv64/smode
```

## zephyr-suite/p1c_fault_handle/testcase.yaml
```yaml
common:
  tags: riscv mmu
tests:
  app.zephyr_suite.p1c:
    # Needs S-mode (satp) + the gated mmu=on this board provides for CONFIG_RISCV_MMU.
    platform_allow:
      - qemu_riscv64/qemu_virt_riscv64/smode
    integration_platforms:
      - qemu_riscv64/qemu_virt_riscv64/smode
```

## zephyr-suite/p2_interrupts/testcase.yaml
```yaml
common:
  tags: riscv interrupt
tests:
  app.zephyr_suite.p2_interrupts:
    platform_allow:
      - qemu_riscv64/qemu_virt_riscv64/smode
    integration_platforms:
      - qemu_riscv64/qemu_virt_riscv64/smode
```

## zephyr-suite/p3_atomics/testcase.yaml
```yaml
common:
  tags: riscv atomics
tests:
  app.zephyr_suite.p3_atomics:
    filter: CONFIG_RISCV_ISA_EXT_A
    platform_allow:
      - qemu_riscv64/qemu_virt_riscv64/smode
    integration_platforms:
      - qemu_riscv64/qemu_virt_riscv64/smode
```

## zephyr-suite/p4_dualcore/testcase.yaml
```yaml
common:
  tags: riscv smp
tests:
  app.zephyr_suite.p4_dualcore:
    filter: CONFIG_SMP
    platform_allow:
      - qemu_riscv64/qemu_virt_riscv64/smp
    integration_platforms:
      - qemu_riscv64/qemu_virt_riscv64/smp
```
